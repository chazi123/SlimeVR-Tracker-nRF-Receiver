## boards/holyiot/holyiot_21017/Kconfig.holyiot_21017
```kconfig
# Copyright (c) 2018 Nordic Semiconductor ASA
# SPDX-License-Identifier: Apache-2.0

config BOARD_HOLYIOT_21017
	select SOC_NRF52840_QIAA

if BOARD_HOLYIOT_21017

config BOARD_HAS_NRF5_BOOTLOADER
	bool "Board has nRF5 bootloader"
	default y
	help
	  If selected, applications are linked so that they can be loaded by Nordic
	  nRF5 bootloader.

config BOARD_SERIAL_BACKEND_CDC_ACM
	bool "USB CDC"
	default y

config MPSL_FEM_GENERIC_TWO_CTRL_PINS_SUPPORT
    bool "Use FEM"
    default y
    help
        Use RF front-end module (FEM) is a device that amplifies the RF signal, to increase the range distance, the strength, and the robustness of a link connection.

config BOARD_ENABLE_FEM
    bool "FEM enabled"
    default y
    select MPSL_FEM_GENERIC_TWO_CTRL_PINS_SUPPORT
    help
      Enable the SKY66112 front-end module. The MPSL options that actually
      drive it live in boards/holyiot_21017_nrf52840.conf.

config BOARD_ENABLE_DCDC
    bool "DCDC mode"
    select SOC_DCDC_NRF52X
    default n

endif # BOARD_HOLYIOT_21017
```
